## yocto/meta-custom-rpi/conf/layer.conf
```bitbake
# We have a conf and classes directory, add to BBPATH
BBPATH .= ":${LAYERDIR}"

# We have recipes-* directories, add to BBFILES
BBFILES += "${LAYERDIR}/recipes-*/*/*.bb \
	${LAYERDIR}/recipes-*/*/*.bbappend"

BBFILE_COLLECTIONS += "cutom-rpi-layer"
BBFILE_PATTERN_cutom-rpi-layer := "^${LAYERDIR}/"
BBFILE_PRIORITY_cutom-rpi-layer = "99"

# This should only be incremented on significant changes that will
# cause compatibility issues with other layers
LAYERVERSION_cutom-rpi-layer = "1"

LAYERDEPENDS_cutom-rpi-layer = "core"
```
